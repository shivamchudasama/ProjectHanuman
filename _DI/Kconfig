## _DI/Kconfig
```kconfig
#*******************************************************************************
#
# Application Kconfig (KCONFIG_ROOT, set in the top-level CMakeLists.txt)
#
#*******************************************************************************
menu "Application"

config DS_HEX_DUMP
	bool "Print every byte of each received hex segment on the log"
	help
	  When enabled, the data store prints each CRC-verified segment as
	  "0xAAAAAAAA: xx xx ..." lines, 16 bytes per line, framed by SEG start
	  and SEG end lines. STORED is sent only after the last line, and the
	  next segment is rejected until then, so a 64 KiB segment holds the
	  upload for several seconds. Use it for debugging.

	  When disabled, each segment is reported with a single
	  "SEG addr=... len=... crc=..." line and STORED follows at once.

config PROV_WIPE_HOLD_MS
	int "Hold time of the provisioning wipe button (ms)"
	default 5000
	range 500 60000
	help
	  Holding DK Button 0 this long wipes the provisioning credentials
	  (device key, CSR, CA and device certificate) and generates a fresh
	  key and CSR, as the DEPROVISION message does. Releasing the button
	  earlier does nothing.

menu "File system manager"

choice FSMGR_FLASH_INTERFACE
	prompt "External flash interface"
	default FSMGR_FLASH_IF_SPI
	help
	  The interface of the external NOR flash that holds the FAT volume
	  (FLASH_DISK). Selected by _DI/conf/flash_<if>.conf together with its
	  devicetree overlay (root CMakeLists.txt, FLASH_IF); used for the mount
	  log line.

config FSMGR_FLASH_IF_SPI
	bool "SPI NOR (jedec,spi-nor on spi00)"

config FSMGR_FLASH_IF_SQSPI
	bool "sQSPI soft peripheral on the FLPR core (jedec,mspi-nor)"

endchoice

config FSMGR_BUFFERED_WRITE
	bool "Collect written data into larger flash writes"
	help
	  The File System Manager collects the data of successive write
	  commands in a RAM buffer and writes it to the file in
	  FSMGR_WRITE_BUFFER_SIZE pieces. Disable it to write every command's
	  data directly.

config FSMGR_WRITE_BUFFER_SIZE
	int "Write buffer size (bytes)"
	depends on FSMGR_BUFFERED_WRITE
	range 240 4096
	default 512
	help
	  Size of the RAM buffer used by FSMGR_BUFFERED_WRITE. Larger values
	  mean fewer flash writes and more RAM.

config FSMGR_STACK_SIZE
	int "File System Manager thread stack size"
	default 4096

config FSMGR_PRIORITY
	int "File System Manager thread priority"
	default 10
	help
	  Keep it below the SETU engine (priority 5), so flash writes
	  never delay the link.

config FSMGR_QUEUE_DEPTH
	int "File System Manager message queue depth"
	default 8
	range 2 64

config FS_CMD
	bool "File commands over BLE (appTypes 0x40-0x4F)"
	default y
	help
	  Lets the host (GUI Files page, setu_client.py fs) create, list,
	  read, write and delete files on the external flash. Like the hex
	  upload, it runs on the unauthenticated host link, so turn it off in
	  production builds.

endmenu

menu "Device pairing"

config PAIR_TIMEOUT_MS
	int "Time limit of a pairing run (ms)"
	default 60000
	range 10000 600000
	help
	  A pairing run (from the host's START to PAIRED) that takes longer
	  fails with error TIMEOUT: the peer link is dropped and the host sees
	  FAILED in the pairing status.

config PAIR_CONNECT_TIMEOUT_MS
	int "Time limit to reach the peer device (ms)"
	default 30000
	range 5000 600000
	help
	  The peripheral advertises directed to the central, and the central
	  scans for the peripheral, for at most this long before the run fails
	  with error TIMEOUT.

endmenu

menu "CAN bus"

config CANIF
	bool "CAN / CAN FD interface (_ASW/_CAN)"
	default y
	depends on CAN
	help
	  Owns the controller chosen as zephyr,canbus (the MCP2518FD Click):
	  sets its mode and bitrates, starts it, follows its state, and gives
	  other modules frame TX and filtered RX. The values below are the
	  boot configuration; gi_CanIf_Configure() changes it at runtime.

if CANIF

config CANIF_FD
	bool "Start in CAN FD mode"
	default y
	depends on CAN_FD_MODE
	help
	  Start the controller in CAN FD mode (classic and FD frames). When
	  disabled it starts as a classic CAN 2.0 controller.

config CANIF_BITRATE
	int "Nominal (arbitration) bitrate (bit/s)"
	default 500000
	range 10000 1000000

config CANIF_BITRATE_DATA
	int "CAN FD data-phase bitrate (bit/s)"
	default 2000000
	range 1000000 8000000
	depends on CAN_FD_MODE
	help
	  Used for frames sent with bit-rate switching (BRS).

config CANIF_LISTEN_ONLY
	bool "Start in listen-only mode"
	help
	  The controller neither acknowledges nor sends frames, so a vehicle
	  bus can be watched without disturbing it. Sending is refused.

config CANIF_SELFTEST
	bool "Loopback self-test at boot"
	help
	  Before the boot configuration is applied, send a classic and (with
	  CAN FD) a 64-byte FD frame in the controller's loopback mode and
	  check they come back. The MCP2518FD's loopback mode is external
	  loopback: the two frames (ID 0x5A5) also go out on the bus. Use it
	  on the bench only, never connected to a vehicle.

config CANIF_LOG_RX
	bool "Log received frames at boot"
	default y
	help
	  Log every received frame (standard and extended IDs) on the UART, at
	  most CANIF_LOG_RX_MAX_PER_SEC a second. gv_CanIf_SetMonitor() turns
	  it on and off at runtime; turn it off while flashing, it costs SPI
	  and CPU time.

config CANIF_LOG_RX_MAX_PER_SEC
	int "Most frames logged per second"
	default 20
	range 1 1000

config CANIF_TEST_TX_PERIOD_MS
	int "Test frame period (ms, 0 = off)"
	default 0
	range 0 60000
	help
	  Send a test frame (ID 0x5A5, a counter; alternately classic and FD
	  with BRS in CAN FD mode) at this period, to check the bus on the
	  bench. Never enable it on a vehicle.

config CANIF_MAX_FILTERS
	int "Receive filters for other modules"
	default 8
	range 1 16
	help
	  Each takes one of the driver's filters
	  (CAN_MCP251XFD_MAX_FILTERS). The traffic log takes two more; leave
	  the rest for ISO-TP.

config CANIF_RX_QUEUE_DEPTH
	int "Receive queue depth (frames and state changes)"
	default 16
	range 4 64

config CANIF_STACK_SIZE
	int "CAN interface thread stack size"
	default 2048

config CANIF_PRIORITY
	int "CAN interface thread priority"
	default 6
	help
	  Below the SETU engine (5), above the File System Manager (10).

endif # CANIF

endmenu

menu "UDS"

config UDS
	bool "UDS diagnostics and ECU flashing over CAN (_LIB/UdsClient, _ASW/_UDS)"
	default y
	depends on CANIF && ISOTP
	help
	  The UDS client (ISO 14229, tester side) on Zephyr's ISO-TP, and the
	  job engine that sends diagnostic requests and flashes stored files
	  to an ECU. _DOC/UDS/README.md.

if UDS

config UDS_CMD
	bool "UDS over BLE (appTypes 0x50-0x5F)"
	default y
	help
	  Lets the host (setu_client.py uds and flash) set the target ECU,
	  send diagnostic requests, unlock, and start a flash job. Like the
	  file commands, it runs on the unauthenticated host link: anyone who
	  can connect can flash a connected ECU. Turn it off in production
	  builds until the host is authenticated.

config UDS_P2_MS
	int "Default P2 (ms)"
	default 150
	range 20 5000
	help
	  Wait for a response until the ECU's session response gives its own
	  P2 (plus 50 ms).

config UDS_P2STAR_MS
	int "Default P2* (ms)"
	default 5000
	range 100 60000
	help
	  Wait after NRC 0x78 (response pending) until the ECU gives its own.

config UDS_TESTER_PRESENT_MS
	int "TesterPresent period in a non-default session (ms)"
	default 2000
	range 500 4500

config UDS_BUSY_RETRIES
	int "Repeats after NRC 0x21 busyRepeatRequest"
	default 3
	range 0 20

config UDS_RESPONSE_MAX
	int "Longest diagnostic response (bytes)"
	default 1024
	range 64 4095

config UDS_FLASH_BLOCK_MAX
	int "Longest TransferData request (bytes)"
	default 2048
	range 16 4095
	help
	  The flash job's block buffer: TransferData requests are the ECU's
	  maxNumberOfBlockLength, capped by this.

config UDS_JOB_STACK_SIZE
	int "UDS job thread stack size"
	default 3072

config UDS_JOB_PRIORITY
	int "UDS job thread priority"
	default 7
	help
	  Below the CAN interface (6), above the File System Manager (10).

endif # UDS

endmenu

menu "Device certificate subject (CSR)"

config CSR_SUBJ_C
	string "Country (C)"
	default "IN"
	help
	  Two-letter country code placed in the CSR subject. The CN is not
	  configurable: it is a UUIDv5 derived from the hardware device ID.

config CSR_SUBJ_ST
	string "State or province (ST)"
	default "Maharashtra"

config CSR_SUBJ_L
	string "Locality (L)"
	default "Pune"

config CSR_SUBJ_O
	string "Organization (O)"
	default "Bajaj Auto Technology Limited"

config CSR_SUBJ_OU
	string "Organizational unit (OU)"
	default "IS Team"

endmenu

endmenu

source "Kconfig.zephyr"
```
